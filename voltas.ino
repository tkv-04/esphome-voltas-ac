/*
 * ============================================================
 *  Voltas AC IR Remote Controller
 *  Remote Model: RG52E1/BGEF
 * ============================================================
 *  Hardware: Arduino Uno + IR LED on pin 4
 *  Protocol: Raw IR timing data captured from original remote
 *  
 *  Serial Commands (115200 baud):
 *    POWER_ON        - Turn AC on (Cool 24°C, Fan Auto)
 *    POWER_OFF       - Turn AC off
 *    TEMP <16-30>    - Set temperature (e.g. TEMP 26)
 *    TEMP_UP         - Increase temp by 1
 *    TEMP_DOWN       - Decrease temp by 1
 *    MODE <mode>     - Set mode: COOL, DRY, HEAT, FAN, AUTO
 *    FAN <speed>     - Set fan: AUTO, LOW, MED, HIGH
 *    SWING_ON        - Enable swing
 *    SWING_OFF       - Disable swing
 *    STATUS          - Print current AC state
 *    HELP            - Show command list
 * ============================================================
 */

#include <IRremote.h>

#define IR_SEND_PIN 4

// ===================== AC STATE TRACKING =====================

struct ACState {
  bool     power;
  int      temp;       // 17–30
  uint8_t  mode;       // 0=COOL, 1=DRY, 2=HEAT, 3=FAN, 4=AUTO
  uint8_t  fan;        // 0=AUTO, 1=LOW, 2=MED, 3=HIGH
  bool     swing;
  bool     led;        // display on/off
};

ACState ac = { false, 24, 0, 0, false, true };

const char* modeNames[]  = { "COOL", "DRY", "HEAT", "FAN", "AUTO" };
const char* fanNames[]   = { "AUTO", "LOW", "MED", "HIGH" };

// =================== RAW IR SIGNAL DATA ======================
// Each array contains the full raw timing captured from the
// original Voltas remote. Signals are sent at 38 kHz.

// -------------------- POWER ON (24°C Cool Auto) --------------------
const uint16_t powerOn[] PROGMEM = {
  4400, 4300, 550, 1650, 500, 550, 550, 1650, 500, 1650, 550, 500,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 550
};
const uint16_t powerOnLen = sizeof(powerOn) / sizeof(powerOn[0]);

// -------------------- POWER OFF --------------------
const uint16_t powerOff[] PROGMEM = {
  4400, 4300, 550, 1650, 550, 500, 550, 1650, 550, 1600, 550, 500,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 500
};
const uint16_t powerOffLen = sizeof(powerOff) / sizeof(powerOff[0]);

// ================ TEMPERATURE SIGNALS ================

const uint16_t temp17[] PROGMEM = {
  4350, 4350, 600, 1550, 600, 500, 550, 1600, 600, 1600, 550, 500,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 550
};
const uint16_t temp17Len = sizeof(temp17) / sizeof(temp17[0]);

const uint16_t temp18[] PROGMEM = {
  4450, 4250, 600, 1600, 550, 400, 700, 1600, 550, 1600, 550, 500,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 500
};
const uint16_t temp18Len = sizeof(temp18) / sizeof(temp18[0]);

const uint16_t temp19[] PROGMEM = {
  4400, 4300, 600, 1600, 550, 550, 550, 1600, 550, 1600, 550, 550,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 500
};
const uint16_t temp19Len = sizeof(temp19) / sizeof(temp19[0]);

const uint16_t temp20[] PROGMEM = {
  4400, 4300, 600, 1600, 550, 500, 600, 1600, 550, 1600, 550, 500,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 500
};
const uint16_t temp20Len = sizeof(temp20) / sizeof(temp20[0]);

const uint16_t temp21[] PROGMEM = {
  4400, 4300, 600, 1600, 550, 500, 600, 1600, 550, 1600, 550, 500,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 550
};
const uint16_t temp21Len = sizeof(temp21) / sizeof(temp21[0]);

const uint16_t temp22[] PROGMEM = {
  4400, 4300, 600, 1600, 550, 500, 600, 1600, 550, 1600, 550, 500,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 500
};
const uint16_t temp22Len = sizeof(temp22) / sizeof(temp22[0]);

const uint16_t temp23[] PROGMEM = {
  4400, 4300, 650, 1550, 600, 500, 600, 1550, 600, 1550, 600, 500,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 500
};
const uint16_t temp23Len = sizeof(temp23) / sizeof(temp23[0]);

const uint16_t temp24[] PROGMEM = {
  4400, 4300, 550, 1650, 500, 550, 550, 1650, 500, 1650, 550, 500,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 550
};
const uint16_t temp24Len = sizeof(temp24) / sizeof(temp24[0]);

const uint16_t temp25[] PROGMEM = {
  4400, 4300, 550, 1650, 550, 500, 550, 1650, 500, 1650, 550, 500,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 550
};
const uint16_t temp25Len = sizeof(temp25) / sizeof(temp25[0]);

const uint16_t temp26[] PROGMEM = {
  4400, 4300, 550, 1600, 600, 500, 600, 1550, 550, 1650, 550, 500,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 550
};
const uint16_t temp26Len = sizeof(temp26) / sizeof(temp26[0]);

const uint16_t temp27[] PROGMEM = {
  4400, 4300, 600, 1600, 550, 500, 600, 1550, 600, 1600, 550, 500,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 600
};
const uint16_t temp27Len = sizeof(temp27) / sizeof(temp27[0]);

const uint16_t temp28[] PROGMEM = {
  4400, 4300, 550, 1600, 550, 500, 600, 1600, 550, 1600, 600, 500,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 550
};
const uint16_t temp28Len = sizeof(temp28) / sizeof(temp28[0]);

const uint16_t temp29[] PROGMEM = {
  4400, 4300, 550, 1650, 550, 450, 600, 1650, 550, 1600, 550, 500,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 550
};
const uint16_t temp29Len = sizeof(temp29) / sizeof(temp29[0]);

const uint16_t temp30[] PROGMEM = {
  4450, 4300, 600, 1550, 600, 500, 550, 1600, 600, 1600, 550, 500,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 550
};
const uint16_t temp30Len = sizeof(temp30) / sizeof(temp30[0]);

// ================ MODE SIGNALS ================

const uint16_t modeCool[] PROGMEM = {
  4400, 4300, 550, 1650, 550, 500, 550, 1650, 500, 1650, 550, 500,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 550
};
const uint16_t modeCoolLen = sizeof(modeCool) / sizeof(modeCool[0]);

const uint16_t modeDry[] PROGMEM = {
  4400, 4300, 550, 1600, 550, 550, 550, 1600, 550, 1600, 550, 550,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 550
};
const uint16_t modeDryLen = sizeof(modeDry) / sizeof(modeDry[0]);

const uint16_t modeHeat[] PROGMEM = {
  4400, 4300, 600, 1600, 550, 500, 550, 1650, 550, 1600, 550, 550,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 500
};
const uint16_t modeHeatLen = sizeof(modeHeat) / sizeof(modeHeat[0]);

const uint16_t modeFan[] PROGMEM = {
  4350, 4350, 600, 1550, 600, 500, 550, 1600, 550, 1600, 600, 500,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 550
};
const uint16_t modeFanLen = sizeof(modeFan) / sizeof(modeFan[0]);

const uint16_t modeAuto[] PROGMEM = {
  4350, 4350, 550, 1600, 550, 550, 500, 1650, 550, 1600, 550, 550,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 550
};
const uint16_t modeAutoLen = sizeof(modeAuto) / sizeof(modeAuto[0]);

// ================ FAN SPEED SIGNALS ================

const uint16_t fanAuto[] PROGMEM = {
  4350, 4350, 550, 1650, 500, 500, 600, 1600, 550, 1650, 500, 500,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 500
};
const uint16_t fanAutoLen = sizeof(fanAuto) / sizeof(fanAuto[0]);

const uint16_t fanLow[] PROGMEM = {
  4350, 4350, 600, 1600, 550, 500, 600, 1550, 600, 1600, 550, 500,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 550
};
const uint16_t fanLowLen = sizeof(fanLow) / sizeof(fanLow[0]);

const uint16_t fanMed[] PROGMEM = {
  4400, 4300, 600, 1600, 550, 500, 600, 1600, 550, 1600, 550, 500,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 550
};
const uint16_t fanMedLen = sizeof(fanMed) / sizeof(fanMed[0]);

const uint16_t fanHigh[] PROGMEM = {
  4350, 4350, 550, 1650, 550, 500, 550, 1650, 500, 1650, 550, 500,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 500
};
const uint16_t fanHighLen = sizeof(fanHigh) / sizeof(fanHigh[0]);

// ================ SWING SIGNALS ================

const uint16_t swingOn[] PROGMEM = {
  4350, 4300, 600, 1600, 550, 500, 600, 1600, 550, 1600, 600, 500,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 600
};
const uint16_t swingOnLen = sizeof(swingOn) / sizeof(swingOn[0]);

const uint16_t swingOff[] PROGMEM = {
  4350, 4300, 600, 1600, 550, 500, 600, 1600, 550, 1600, 550, 500,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 600
};
const uint16_t swingOffLen = sizeof(swingOff) / sizeof(swingOff[0]);

// ================ LED DISPLAY SIGNALS ================

const uint16_t ledOn[] PROGMEM = {
  4400, 4300, 600, 1550, 650, 450, 550, 1600, 600, 1600, 550, 500,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 600
};
const uint16_t ledOnLen = sizeof(ledOn) / sizeof(ledOn[0]);

const uint16_t ledOff[] PROGMEM = {
  4350, 4350, 550, 1600, 550, 550, 550, 1600, 550, 1650, 500, 550,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 600
};
const uint16_t ledOffLen = sizeof(ledOff) / sizeof(ledOff[0]);

// =================== HELPER: SEND RAW FROM PROGMEM ===================
// Arduino Uno has limited SRAM (~2KB), so we read from PROGMEM in chunks

void sendRawFromProgmem(const uint16_t* data, uint16_t len) {
  // IRremote's sendRaw needs the data in RAM.
  // We copy small chunks at a time to avoid blowing SRAM.
  // But for reliability, we allocate a temporary buffer.
  // On Uno, max signal is ~200 entries = 400 bytes — fits.
  
  uint16_t* buf = (uint16_t*)malloc(len * sizeof(uint16_t));
  if (!buf) {
    Serial.println(F("ERROR: Out of memory!"));
    return;
  }
  
  for (uint16_t i = 0; i < len; i++) {
    buf[i] = pgm_read_word(&data[i]);
  }
  
  IrSender.sendRaw(buf, len, 38);
  free(buf);
}

// =================== COMMAND HANDLERS ===================

void sendPowerOn() {
  Serial.println(F(">> POWER ON (Cool 24°C Fan Auto)"));
  sendRawFromProgmem(powerOn, powerOnLen);
  ac.power = true;
  ac.temp  = 24;
  ac.mode  = 0;  // COOL
  ac.fan   = 0;  // AUTO
  ac.swing = false;
}

void sendPowerOff() {
  Serial.println(F(">> POWER OFF"));
  sendRawFromProgmem(powerOff, powerOffLen);
  ac.power = false;
}

void sendTemp(int t) {
  if (t < 17 || t > 30) {
    Serial.println(F("ERROR: Temp must be 17-30"));
    return;
  }
  
  Serial.print(F(">> SET TEMP: "));
  Serial.print(t);
  Serial.println(F("°C"));
  
  switch (t) {
    case 17: sendRawFromProgmem(temp17, temp17Len); break;
    case 18: sendRawFromProgmem(temp18, temp18Len); break;
    case 19: sendRawFromProgmem(temp19, temp19Len); break;
    case 20: sendRawFromProgmem(temp20, temp20Len); break;
    case 21: sendRawFromProgmem(temp21, temp21Len); break;
    case 22: sendRawFromProgmem(temp22, temp22Len); break;
    case 23: sendRawFromProgmem(temp23, temp23Len); break;
    case 24: sendRawFromProgmem(temp24, temp24Len); break;
    case 25: sendRawFromProgmem(temp25, temp25Len); break;
    case 26: sendRawFromProgmem(temp26, temp26Len); break;
    case 27: sendRawFromProgmem(temp27, temp27Len); break;
    case 28: sendRawFromProgmem(temp28, temp28Len); break;
    case 29: sendRawFromProgmem(temp29, temp29Len); break;
    case 30: sendRawFromProgmem(temp30, temp30Len); break;
  }
  ac.temp = t;
}

void sendMode(uint8_t m) {
  Serial.print(F(">> SET MODE: "));
  Serial.println(modeNames[m]);
  
  switch (m) {
    case 0: sendRawFromProgmem(modeCool, modeCoolLen); break;
    case 1: sendRawFromProgmem(modeDry,  modeDryLen);  break;
    case 2: sendRawFromProgmem(modeHeat, modeHeatLen); break;
    case 3: sendRawFromProgmem(modeFan,  modeFanLen);  break;
    case 4: sendRawFromProgmem(modeAuto, modeAutoLen); break;
  }
  ac.mode = m;
}

void sendFan(uint8_t f) {
  Serial.print(F(">> SET FAN: "));
  Serial.println(fanNames[f]);
  
  switch (f) {
    case 0: sendRawFromProgmem(fanAuto, fanAutoLen); break;
    case 1: sendRawFromProgmem(fanLow,  fanLowLen);  break;
    case 2: sendRawFromProgmem(fanMed,  fanMedLen);  break;
    case 3: sendRawFromProgmem(fanHigh, fanHighLen); break;
  }
  ac.fan = f;
}

void sendSwing(bool on) {
  Serial.print(F(">> SWING: "));
  Serial.println(on ? F("ON") : F("OFF"));
  
  if (on) {
    sendRawFromProgmem(swingOn, swingOnLen);
  } else {
    sendRawFromProgmem(swingOff, swingOffLen);
  }
  ac.swing = on;
}

void sendLed(bool on) {
  Serial.print(F(">> LED DISPLAY: "));
  Serial.println(on ? F("ON") : F("OFF"));
  
  if (on) {
    sendRawFromProgmem(ledOn, ledOnLen);
  } else {
    sendRawFromProgmem(ledOff, ledOffLen);
  }
  ac.led = on;
}

void printStatus() {
  Serial.println(F(""));
  Serial.println(F("===== AC STATUS ====="));
  Serial.print(F("  Power : ")); Serial.println(ac.power ? F("ON") : F("OFF"));
  Serial.print(F("  Temp  : ")); Serial.print(ac.temp); Serial.println(F("°C"));
  Serial.print(F("  Mode  : ")); Serial.println(modeNames[ac.mode]);
  Serial.print(F("  Fan   : ")); Serial.println(fanNames[ac.fan]);
  Serial.print(F("  Swing : ")); Serial.println(ac.swing ? F("ON") : F("OFF"));
  Serial.print(F("  LED   : ")); Serial.println(ac.led ? F("ON") : F("OFF"));
  Serial.println(F("====================="));
  Serial.println(F(""));
}

void printHelp() {
  Serial.println(F(""));
  Serial.println(F("======= VOLTAS AC REMOTE - COMMANDS ======="));
  Serial.println(F("  POWER_ON         Turn AC on"));
  Serial.println(F("  POWER_OFF        Turn AC off"));
  Serial.println(F("  TEMP <17-30>     Set temperature"));
  Serial.println(F("  TEMP_UP          Increase temp +1"));
  Serial.println(F("  TEMP_DOWN        Decrease temp -1"));
  Serial.println(F("  MODE <mode>      COOL|DRY|HEAT|FAN|AUTO"));
  Serial.println(F("  FAN <speed>      AUTO|LOW|MED|HIGH"));
  Serial.println(F("  SWING_ON         Enable swing"));
  Serial.println(F("  SWING_OFF        Disable swing"));
  Serial.println(F("  LED_ON           Display on"));
  Serial.println(F("  LED_OFF          Display off"));
  Serial.println(F("  STATUS           Show current state"));
  Serial.println(F("  HELP             Show this menu"));
  Serial.println(F("============================================="));
  Serial.println(F(""));
}

// =================== SERIAL COMMAND PARSER ===================

String inputBuffer = "";

void processCommand(String cmd) {
  cmd.trim();
  cmd.toUpperCase();
  
  if (cmd.length() == 0) return;
  
  Serial.print(F("[CMD] "));
  Serial.println(cmd);
  
  // ---------- POWER ----------
  if (cmd == "POWER_ON") {
    sendPowerOn();
  }
  else if (cmd == "POWER_OFF") {
    sendPowerOff();
  }
  // ---------- TEMPERATURE ----------
  else if (cmd.startsWith("TEMP ")) {
    int t = cmd.substring(5).toInt();
    sendTemp(t);
  }
  else if (cmd == "TEMP_UP") {
    if (ac.temp < 30) {
      sendTemp(ac.temp + 1);
    } else {
      Serial.println(F("Already at max temp (30)"));
    }
  }
  else if (cmd == "TEMP_DOWN") {
    if (ac.temp > 17) {
      sendTemp(ac.temp - 1);
    } else {
      Serial.println(F("Already at min temp (17)"));
    }
  }
  // ---------- MODE ----------
  else if (cmd.startsWith("MODE ")) {
    String m = cmd.substring(5);
    m.trim();
    if      (m == "COOL") sendMode(0);
    else if (m == "DRY")  sendMode(1);
    else if (m == "HEAT") sendMode(2);
    else if (m == "FAN")  sendMode(3);
    else if (m == "AUTO") sendMode(4);
    else Serial.println(F("ERROR: Mode must be COOL|DRY|HEAT|FAN|AUTO"));
  }
  // ---------- FAN ----------
  else if (cmd.startsWith("FAN ")) {
    String f = cmd.substring(4);
    f.trim();
    if      (f == "AUTO") sendFan(0);
    else if (f == "LOW")  sendFan(1);
    else if (f == "MED")  sendFan(2);
    else if (f == "HIGH") sendFan(3);
    else Serial.println(F("ERROR: Fan must be AUTO|LOW|MED|HIGH"));
  }
  // ---------- SWING ----------
  else if (cmd == "SWING_ON") {
    sendSwing(true);
  }
  else if (cmd == "SWING_OFF") {
    sendSwing(false);
  }
  // ---------- LED ----------
  else if (cmd == "LED_ON") {
    sendLed(true);
  }
  else if (cmd == "LED_OFF") {
    sendLed(false);
  }
  // ---------- STATUS / HELP ----------
  else if (cmd == "STATUS") {
    printStatus();
  }
  else if (cmd == "HELP") {
    printHelp();
  }
  else {
    Serial.print(F("Unknown command: "));
    Serial.println(cmd);
    Serial.println(F("Type HELP for available commands"));
  }
  
  Serial.println(F("OK"));
}

// =================== SETUP & LOOP ===================

void setup() {
  Serial.begin(115200);
  while (!Serial) { ; }  // Wait for serial on Uno
  
  IrSender.begin(IR_SEND_PIN);
  
  Serial.println(F(""));
  Serial.println(F("============================================"));
  Serial.println(F("  Voltas AC IR Controller v2.0"));
  Serial.println(F("  Remote: RG52E1/BGEF"));
  Serial.println(F("  IR LED: Pin 4 | Carrier: 38kHz"));
  Serial.println(F("============================================"));
  Serial.println(F("  Type HELP for commands"));
  Serial.println(F("============================================"));
  Serial.println(F(""));
}

void loop() {
  // Read serial commands character by character
  while (Serial.available()) {
    char c = Serial.read();
    
    if (c == '\n' || c == '\r') {
      if (inputBuffer.length() > 0) {
        processCommand(inputBuffer);
        inputBuffer = "";
      }
    } else {
      inputBuffer += c;
    }
  }
}